## boards/shields/chrummoled/Kconfig.defconfig
```kconfig
if SHIELD_CHRUMMOLED

config ZMK_KEYBOARD_NAME
    default "Chrummoled"




endif 
```

## boards/shields/chrummv2/Kconfig.defconfig
```kconfig
if SHIELD_CHRUMMV2

config ZMK_KEYBOARD_NAME
    default "Chrummv2"

config SPI
    default y


endif # SHIELD_CHRUMMV2
```

## config/west.yml
```yaml
manifest:
  remotes:
    - name: zmkfirmware
      url-base: https://github.com/zmkfirmware
    - name: sbmelb
      url-base: https://github.com/sbmelb

  projects:
    - name: zmk
      remote: zmkfirmware
      revision: main
      import: app/west.yml

    - name: zmk-oled-adapter
      remote: sbmelb
      revision: main
      path: modules/zmk-oled-adapter

  self:
    path: config
```
